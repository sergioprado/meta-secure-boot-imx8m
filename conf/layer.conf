## conf/layer.conf
```bitbake
# We have a conf and classes directory, add to BBPATH
BBPATH .= ":${LAYERDIR}"

# We have recipes-* directories, add to BBFILES
BBFILES += "${LAYERDIR}/recipes-*/*/*.bb \
            ${LAYERDIR}/recipes-*/*/*.bbappend"

BBFILE_COLLECTIONS += "meta-secure-boot-imx8m"
BBFILE_PATTERN_meta-secure-boot-imx8m = "^${LAYERDIR}/"
BBFILE_PRIORITY_meta-secure-boot-imx8m = "99"

LAYERDEPENDS_meta-secure-boot-imx8m = "core"
LAYERSERIES_COMPAT_meta-secure-boot-imx8m = "scarthgap"
```
